# CY8C4247LQI_BL483 register map
File version: 0.1
PSoC 4200 BLE
Registers are 8-bit, read-write, no defined reset value unless marked. A register's access mark holds for its fields unless they carry their own. Offsets are from the block's base; lines under a group give offsets from that group; [hi:lo] are bit positions; {n}, {i} and the like mark numbered series; 'fields as' and 'values as' point back to an identical list; <NAME> marks a mode.

## Memory map
0x400F0002 PrISM_2 — PrISM
0x400F0003 PrISM_1 — PrISM

## PrISM_2 — PrISM
Base 0x400F0002
Same registers: PrISM_1 0x400F0003
0x00 PrISM_SEED — Current seed value
0x10 PrISM_POLYNOM — Polynomial
0x20 PrISM_DENSITY0 — Pulse Density 0
0x30 PrISM_DENSITY1 — Pulse Density 1
0x40 PrISM_SEED_COPY — Start seed value
0x70 PrISM_CONTROL 3-bit — Control register
  [2] compare_type1 — XX
  [1] compare_type0
  [0] ctrl_enable
